## conf/distro/mejate-musl.conf
```bitbake
require conf/distro/poky.conf

DISTRO = "mejate-musl"
DISTRO_NAME = "Meta Java Test with musl"
DISTROOVERRIDES = "poky"
TCLIBC = "musl"
```

## conf/distro/mejate.conf
```bitbake
require conf/distro/poky.conf

DISTRO = "mejate"
DISTRO_NAME = "Meta Java Test"
DISTROOVERRIDES = "poky"
```

## conf/layer.conf
```bitbake
# We have a conf and classes directory, append to BBPATH
BBPATH .= ":${LAYERDIR}"

# We have a recipes directory, add to BBFILES
BBFILES += "${LAYERDIR}/recipes*/*/*.bb ${LAYERDIR}/recipes*/*/*.bbappend"

BBFILE_COLLECTIONS += "meta-java"
BBFILE_PATTERN_meta-java := "^${LAYERDIR}/"
BBFILE_PRIORITY_meta-java = "10"
LAYERSERIES_COMPAT_meta-java = "dunfell"
LAYERDEPENDS_meta-java += "openembedded-layer"

LICENSE_PATH += "${LAYERDIR}/licenses"

SIGGEN_EXCLUDERECIPES_ABISAFE += "\
    ca-certificates-java \
"

SSTATE_EXCLUDEDEPS_SYSROOT += "\
    openjdk-8-native->(ant-native|attr-native|coreutils-native|icedtea7-native|libxslt-native|make-native|openssl-native|zip-native|unzip-native) \
"
```
